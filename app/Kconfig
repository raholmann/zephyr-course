## app/Kconfig
```kconfig
menu "App Led"

    config APP_HEARTBEAT_PERIOD_MS
        int "Heartbeat period ms (0-100)"
        default 500
        range 100 2000
        help
            LED period

endmenu

menu "Zephyr Configuration"
    source "Kconfig.zephyr"
endmenu
```

## app/boards/my_board_disco/Kconfig.my_board_disco
```kconfig
# Copyright (c) 2016 Linaro Limited.
# SPDX-License-Identifier: Apache-2.0

config BOARD_MY_BOARD_DISCO
	select SOC_STM32F407XG
```

## app/boards/my_board_disco/board.yml
```yaml
board:
  name: my_board_disco
  full_name: STM32F4 Discovery
  vendor: st
  socs:
    - name: stm32f407xx
```
